## versions/YDP295B001-V1/examples/st7701s_mipi_dsi/sdkconfig.defaults
```kconfig
CONFIG_ESPTOOLPY_FLASHMODE_QIO=y
CONFIG_ESPTOOLPY_FLASHFREQ_80M=y
CONFIG_ESPTOOLPY_FLASHSIZE_16MB=y

CONFIG_SPIRAM=y
CONFIG_SPIRAM_MODE_HEX=y
CONFIG_SPIRAM_SPEED_200M=y

# 使用partitions.csv
CONFIG_PARTITION_TABLE_CUSTOM=y

CONFIG_COMPILER_OPTIMIZATION_PERF=y

# RGB888
CONFIG_LV_COLOR_DEPTH_24=y
CONFIG_LV_COLOR_DEPTH=24

# lvgl字体大小
CONFIG_LV_FONT_MONTSERRAT_16=y
```
